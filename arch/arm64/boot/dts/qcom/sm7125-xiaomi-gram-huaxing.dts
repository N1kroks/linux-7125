// SPDX-License-Identifier: GPL-2.0
/*
 * Copyright (c) 2023, Joe Mason <buddyjojo06@outlook.com>
 */

/dts-v1/;

#include "sm7125-xiaomi-gram.dtsi"

/ {
	model = "Xiaomi POCO M2 Pro (Huaxing)";
	compatible = "xiaomi,gram", "qcom,sm7125";
};

&panel { compatible = "mdss,ft8756-huaxing"; };
&touchscreen {
	compatible = "focaltech,ft8756-spi";
	firmware-name = "focaltech_ts_fw_huaxing.bin";
	reset-gpio = <&tlmm 8 GPIO_ACTIVE_LOW>;
};