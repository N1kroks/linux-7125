// SPDX-License-Identifier: GPL-2.0
/*
 * Copyright (c) 2021, The Linux Foundation. All rights reserved.
 */

/dts-v1/;

#include "sm7125-xiaomi-joyeuse.dtsi"

/ {
	model = "Xiaomi Redmi Note 9 Pro (Global, Tianma)";
	compatible = "xiaomi,joyeuse", "qcom,sm7125";
};

&panel { compatible = "mdss,nt36675-tianma"; };