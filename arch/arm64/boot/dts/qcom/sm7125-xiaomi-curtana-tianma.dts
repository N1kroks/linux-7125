// SPDX-License-Identifier: GPL-2.0
/*
 * Copyright (c) 2023, Joe Mason <buddyjojo06@outlook.com>
 */

/dts-v1/;

#include "sm7125-xiaomi-curtana.dtsi"

/ {
	model = "Xiaomi Redmi Note 9S (Tianma)";
	compatible = "xiaomi,curtana", "qcom,sm7125";
};

&panel { compatible = "mdss,nt36675-tianma"; };
&touchscreen { 
	compatible = "novatek,nt36xxx-spi"; 
	firmware-name = "novatek_ts_tianma_fw.bin";
};